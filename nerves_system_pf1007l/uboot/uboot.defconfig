## nerves_system_pf1007l/uboot/uboot.defconfig
```kconfig
CONFIG_ARM=y
CONFIG_ARCH_SUNXI=y
CONFIG_DEFAULT_DEVICE_TREE="sun8i-a33-pf1007l"
CONFIG_SPL=y
CONFIG_MACH_SUN8I_A33=y
CONFIG_DRAM_CLK=456
CONFIG_DRAM_ZQ=15291
# CONFIG_VIDEO_SUNXI is not set
# CONFIG_SYS_MALLOC_CLEAR_ON_INIT is not set
CONFIG_CONS_INDEX=5
CONFIG_BOOTDELAY=-2
CONFIG_SUNXI_NO_PMIC=y
CONFIG_SYS_CLK_FREQ=408000000
# CONFIG_ANDROID_BOOT_IMAGE is not set
CONFIG_USE_BOOTCOMMAND=y
CONFIG_BOOTCOMMAND="run nerves_boot"
CONFIG_CMD_SQUASHFS=y
CONFIG_CMD_SYSBOOT=y
# CONFIG_ENV_IS_IN_FAT is not set
CONFIG_ENV_IS_IN_MMC=y
CONFIG_ENV_OFFSET=0x400000
CONFIG_ENV_SIZE=0x4000
CONFIG_SYS_MMC_ENV_DEV=0
CONFIG_FS_SQUASHFS=y
```
